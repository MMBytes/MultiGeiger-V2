## main/Kconfig.projbuild
```kconfig
menu "MultiGeiger"

    config GEIGER_LORAWAN
        bool "LoRaWAN uplink support (SX1262 boards: Heltec WiFi LoRa 32 V4, XIAO ESP32-S3 + Wio-SX1262)"
        default n
        help
            Compiles main/lorawan.cpp and pulls the jgromes/radiolib
            managed component. Set ONLY by
            sdkconfig.defaults.heltec_wifi_lora32_v4_r2 and (V2.8.11)
            sdkconfig.defaults.seeed_xiao_esp32s3_wio — the boards with an
            SX1262 wired in; per-board radio values come from hal.h. Other
            boards must keep
            this off; the ringfence guarantee is that no RadioLib code
            links into their binaries.

endmenu
```
